/*************************************
USB Tester OLED Display
Created by: William Garrido
Created: 01/10/2013
This displays the current and voltage from the USB Tester to the OLED display using the OLED Backpack
Kits are aviaible at www.tindie.com and more info can be found on www.friedcircuits.us
**************************************/

#include <Wire.h>
#include <SPI.h>
#include <Adafruit_INA219.h>
#include <Adafruit_GFX.h>
#include <Adafruit_SSD1306.h>


#define OLED_DC 5
#define OLED_CS SS
#define OLED_CLK SCK
#define OLED_MOSI MOSI
#define OLED_RESET 9

const int LEDPIN = 13;
int ledWarn = 350; //Threshold in mA


//Current Sensor
Adafruit_INA219 ina219;

const int OLED_REFRESH_SPEED = 100; //Refresh loop delay
int graphX = 84; //Start of X for graph
int graphY = 0;  //y placement of graph

//Init OLED Display
Adafruit_SSD1306 display(OLED_MOSI, OLED_CLK, OLED_DC, OLED_RESET, OLED_CS);

  
//FriedCircuits Logo for startup 
static unsigned char PROGMEM FriedCircuitsUSBTester[] = 
{
0x00, 0x00, 0x00, 0x00, 0x00, 0x00, 0x00, 0x0F, 0x0F, 0x87, 0x87, 0xC0, 0x0C, 0x41, 0x86, 0x00,
0x00, 0x00, 0x00, 0x00, 0x00, 0x00, 0x00, 0x00, 0x00, 0x00, 0x00, 0x00, 0x0C, 0x41, 0x86, 0x00,
0x00, 0x00, 0x00, 0x00, 0x00, 0x00, 0x00, 0x00, 0x00, 0x00, 0x00, 0x00, 0x0C, 0x40, 0xCC, 0x70,
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0x03, 0xFC, 0x00, 0x00, 0x00, 0x7F, 0x07, 0xE0, 0x00, 0x00, 0x1C, 0x0C, 0x0C, 0x40, 0x18, 0x30
};


void setup()
{
  
  pinMode(LEDPIN, OUTPUT);
  digitalWrite(LEDPIN, HIGH);
  
  Serial.begin(115200);
  Serial.println("USB Tester OLED Backup Online");
   
  //Init current sensor
  ina219.begin();
  
  //by default, we'll generate the high voltage from the 3.3v line internally! (neat!)
  display.begin(SSD1306_SWITCHCAPVCC);
 
  
  //show splashscreen
  display.clearDisplay(); 
  display.drawBitmap(0, 0, FriedCircuitsUSBTester, 128, 24, WHITE);
  display.display();
  delay(5000);
  display.clearDisplay();   // clears the screen and buffer
  
  digitalWrite(LEDPIN, LOW);
  
}


void loop()
{
 
  float shuntvoltage = 0;
  float busvoltage = 0;
  float current_mA = 0;
  float loadvoltage = 0;
  
  shuntvoltage = ina219.getShuntVoltage_mV();
  busvoltage = ina219.getBusVoltage_V();
  current_mA = ina219.getCurrent_mA();
  loadvoltage = busvoltage + (shuntvoltage / 1000);
  
  //Filters out odd readings when there is no load
  if (shuntvoltage > 6000) shuntvoltage = 0.00;
  if (current_mA > 6000) current_mA = 0.00;
  
  //Setup placement for sensor readouts
  display.setTextSize(1);
  display.setTextColor(WHITE);
  display.setCursor(0,0);
  //Clear Sensor area for next redraw
  display.fillRect(0, 0, 83, 32, BLACK);
  
  //Set x,y and print sensor data
  display.setCursor(0,0);
  display.print("BVolt:");
  display.print(busvoltage);   display.println("V");
  display.print("SVolt:");
  display.print(shuntvoltage);   display.println("mV");
  display.print("Volt:");
  display.print(loadvoltage);   display.println("V");
  display.print("Curr:");
  display.print(current_mA);   display.print(" mA");
  display.display();
  
//  Serial.print(0x02, HEX);
  Serial.print(":");
  Serial.print(busvoltage);
  Serial.print(":");
  Serial.print(shuntvoltage);
  Serial.print(":");
  Serial.print(loadvoltage);
  Serial.print(":");
  Serial.print(current_mA);
  Serial.print(":");
  Serial.print(freeRam());
  Serial.println(":");
  //Serial.print(0x03, HEX);
  
  //Refresh graph from current sensor data
  display.fillRect(graphX, 0, 1, 32, BLACK);
  
  graphY = mapf(current_mA, 0, 500, 32, 0);

  display.drawPixel(graphX, graphY, WHITE);
 
  graphX++; 
  
  if (graphX >= 128) graphX = 84; //Restart graph once we are at edge of display
  
  if (Serial.available() > 0){

     char in[4];
     int index = 0;
     
     while (Serial.available() > 0) {

        in[index] = Serial.read();
        index++;
     
     }
     in[index] ='\0';
     ledWarn = atoi(in);
  }
  
  if (current_mA >= ledWarn){
   
    digitalWrite(LEDPIN, HIGH);
    
  }
  else {
    
     digitalWrite(LEDPIN, LOW);
  }
  
  delay(OLED_REFRESH_SPEED); 

}


//Copy of Arduino map function converted for floats
float mapf(float x, float in_min, float in_max, float out_min, float out_max)
{
  return (x - in_min) * (out_max - out_min) / (in_max - in_min) + out_min;
}


int freeRam () {
  extern int __heap_start, *__brkval;
  int v;
  return (int) &v - (__brkval == 0 ? (int) &__heap_start : (int) __brkval);
}

